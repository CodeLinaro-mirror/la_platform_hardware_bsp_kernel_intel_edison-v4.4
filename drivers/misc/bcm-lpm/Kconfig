## drivers/misc/bcm-lpm/Kconfig
```kconfig
config BCM_BT_LPM
	tristate "Broadcom Bluetooth Low Power Mode"
	depends on SERIAL_8250
	default m
	help
	   Select this module for Broadcom Bluetooth low power management.
```
